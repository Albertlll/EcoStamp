#include <Arduino.h>
#include "qrcode.h"

#define PAPER_WIDTH 384
#define LINE_BYTES (PAPER_WIDTH / 8)
#define FONT_W 5
#define FONT_H 7
#define FONT_SCALE 3
#define CHAR_SPACING 2
#define MAX_ITEMS 4
#define BUTTON_PIN 33
#define BUTTON_DEBOUNCE_MS 35

static const char* RICKROLL_URL = "https://youtu.be/dQw4w9WgXcQ";

static const uint8_t FONT_5X7[][5] PROGMEM = {
  {0x00,0x00,0x00,0x00,0x00},{0x00,0x00,0x5F,0x00,0x00},{0x00,0x07,0x00,0x07,0x00},
  {0x14,0x7F,0x14,0x7F,0x14},{0x24,0x2A,0x7F,0x2A,0x12},{0x23,0x13,0x08,0x64,0x62},
  {0x36,0x49,0x55,0x22,0x50},{0x00,0x05,0x03,0x00,0x00},{0x00,0x1C,0x22,0x41,0x00},
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  {0x00,0x41,0x36,0x08,0x00},{0x10,0x08,0x08,0x10,0x08},{0x00,0x00,0x00,0x00,0x00},
};

static const uint8_t CRC8_TABLE[256] PROGMEM = {
  0x00,0x07,0x0e,0x09,0x1c,0x1b,0x12,0x15,0x38,0x3f,0x36,0x31,
  0x24,0x23,0x2a,0x2d,0x70,0x77,0x7e,0x79,0x6c,0x6b,0x62,0x65,
  0x48,0x4f,0x46,0x41,0x54,0x53,0x5a,0x5d,0xe0,0xe7,0xee,0xe9,
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  0xfa,0xfd,0xf4,0xf3
};

// QR хранится побитово: (size*size+7)/8 байт
// version 2 = 25x25 = 625 бит = 79 байт
#define QR_VERSION 4
#define QR_SIZE (17 + QR_VERSION * 4)
#define QR_BUF_BYTES ((QR_SIZE * QR_SIZE + 7) / 8)

static uint8_t qr_bitbuf[QR_BUF_BYTES];
static uint8_t qr_size_actual = 0;

bool generate_qr(const char* data) {
  QRCode qr;
  uint8_t qrbuf[qrcode_getBufferSize(QR_VERSION)];
  if (qrcode_initText(&qr, qrbuf, QR_VERSION, ECC_MEDIUM, data) != 0)
    return false;
  qr_size_actual = qr.size;
  memset(qr_bitbuf, 0, QR_BUF_BYTES);
  for (uint8_t y = 0; y < qr.size; y++)
    for (uint8_t x = 0; x < qr.size; x++)
      if (qrcode_getModule(&qr, x, y)) {
        uint16_t bit = y * qr.size + x;
        qr_bitbuf[bit >> 3] |= (0x80 >> (bit & 7));
      }
  return true;
}

bool qr_get(uint8_t x, uint8_t y) {
  uint16_t bit = (uint16_t)y * qr_size_actual + x;
  return (qr_bitbuf[bit >> 3] >> (7 - (bit & 7))) & 1;
}

// ---- items ----

struct TextItem {
  int16_t x, y;
  const char* str;
  uint8_t scale;
  bool rotated;
};

struct QrItem {
  int16_t x, y;
  uint8_t pixel_size;
};

static TextItem text_items[MAX_ITEMS];
static uint8_t  text_count = 0;
static QrItem   qr_items[MAX_ITEMS];
static uint8_t  qr_count = 0;

void reset_items() { text_count = 0; qr_count = 0; }

uint16_t string_pixel_width(const char* str, uint8_t scale) {
  uint16_t len = strlen(str);
  if (!len) return 0;
  return len * (FONT_W + CHAR_SPACING) * scale - CHAR_SPACING * scale;
}

void add_text(int16_t x, int16_t y, const char* str, uint8_t scale, bool rotated) {
  if (text_count >= MAX_ITEMS) return;
  text_items[text_count++] = {x, y, str, scale, rotated};
}

void add_text_centered(uint16_t y, const char* str, uint8_t scale) {
  int16_t x = (PAPER_WIDTH - (int16_t)string_pixel_width(str, scale)) / 2;
  add_text(x, y, str, scale, false);
}

void add_text_rotated(int16_t x, int16_t y, const char* str, uint8_t scale) {
  add_text(x, y, str, scale, true);
}

void add_qr(int16_t x, int16_t y, uint8_t pixel_size) {
  if (qr_count >= MAX_ITEMS) return;
  qr_items[qr_count++] = {x, y, pixel_size};
}

void add_qr_centered(uint16_t y, uint8_t pixel_size) {
  int16_t x = (PAPER_WIDTH - (int16_t)(qr_size_actual * pixel_size)) / 2;
  add_qr(x, y, pixel_size);
}

// ---- protocol ----

uint8_t crc8(const uint8_t* data, uint16_t len) {
  uint8_t crc = 0;
  for (uint16_t i = 0; i < len; i++)
    crc = pgm_read_byte(&CRC8_TABLE[(crc ^ data[i]) & 0xFF]);
  return crc;
}

uint8_t reverse_bits(uint8_t b) {
  b = ((b & 0xAA) >> 1) | ((b & 0x55) << 1);
  b = ((b & 0xCC) >> 2) | ((b & 0x33) << 2);
  return ((b & 0xF0) >> 4) | ((b & 0x0F) << 4);
}

void send_command(uint8_t cmd, const uint8_t* payload, uint16_t plen) {
  uint8_t hdr[6] = {0x51,0x78,cmd,0x00,(uint8_t)(plen&0xFF),0x00};
  Serial.write(hdr, 6);
  Serial.write(payload, plen);
  Serial.write(crc8(payload, plen));
  Serial.write((uint8_t)0xFF);
}

void send_command_1(uint8_t cmd, uint8_t val)    { send_command(cmd, &val, 1); }
void send_command_2(uint8_t cmd, uint16_t val)   {
  uint8_t b[2] = {(uint8_t)(val&0xFF),(uint8_t)(val>>8)};
  send_command(cmd, b, 2);
}

// ---- render ----

void canvas_set_px(uint8_t* row_buf, int16_t px) {
  if (px >= 0 && px < PAPER_WIDTH)
    row_buf[px >> 3] |= (0x80 >> (px & 7));
}

void render_row(uint8_t* row_buf, uint16_t y) {
  memset(row_buf, 0, LINE_BYTES);

  for (uint8_t t = 0; t < text_count; t++) {
    const TextItem& ti = text_items[t];
    if (!ti.rotated) {
      int16_t rel_y = (int16_t)y - ti.y;
      if (rel_y < 0 || rel_y >= FONT_H * (int16_t)ti.scale) continue;
      uint8_t font_row = rel_y / ti.scale;
      int16_t cx = ti.x;
      for (const char* p = ti.str; *p; p++, cx += (FONT_W + CHAR_SPACING) * ti.scale) {
        if (*p < 32 || *p > 127) continue;
        uint8_t idx = *p - 32;
        for (uint8_t col = 0; col < FONT_W; col++) {
          if (pgm_read_byte(&FONT_5X7[idx][col]) & (1 << font_row))
            for (uint8_t sx = 0; sx < ti.scale; sx++)
              canvas_set_px(row_buf, cx + col * ti.scale + sx);
        }
      }
    } else {
      for (uint16_t ci = 0; ci < strlen(ti.str); ci++) {
        char c = ti.str[ci];
        if (c < 32 || c > 127) continue;
        int16_t char_y_start = ti.y + ci * (FONT_W + CHAR_SPACING) * (int16_t)ti.scale;
        int16_t rel_y = (int16_t)y - char_y_start;
        if (rel_y < 0 || rel_y >= FONT_W * (int16_t)ti.scale) continue;
        uint8_t font_col = rel_y / ti.scale;
        uint8_t coldata = pgm_read_byte(&FONT_5X7[c - 32][font_col]);
        for (uint8_t row = 0; row < FONT_H; row++)
          if (coldata & (1 << row))
            for (uint8_t sx = 0; sx < ti.scale; sx++)
              canvas_set_px(row_buf, ti.x + (FONT_H - 1 - row) * ti.scale + sx);
      }
    }
  }

  for (uint8_t q = 0; q < qr_count; q++) {
    const QrItem& qi = qr_items[q];
    int16_t rel_y = (int16_t)y - qi.y;
    if (rel_y < 0 || rel_y >= (int16_t)(qr_size_actual * qi.pixel_size)) continue;
    uint8_t qr_row = rel_y / qi.pixel_size;
    for (uint8_t qx = 0; qx < qr_size_actual; qx++)
      if (qr_get(qx, qr_row))
        for (uint8_t ps = 0; ps < qi.pixel_size; ps++)
          canvas_set_px(row_buf, qi.x + qx * qi.pixel_size + ps);
  }
}

void send_row(uint8_t* row_buf) {
  uint8_t out[LINE_BYTES];
  for (uint8_t i = 0; i < LINE_BYTES; i++)
    out[i] = reverse_bits(row_buf[i]);
  send_command(0xA2, out, LINE_BYTES);
}

void print_label(uint16_t label_height, uint16_t energy) {
  uint8_t row_buf[LINE_BYTES];
  uint8_t p = 0x00;
  const uint8_t raw_init[] = {0x51,0x78,0xA3,0x00,0x01,0x00,0x00,0x00,0xFF};
  const uint8_t p_start[]  = {0xAA,0x55,0x17,0x38,0x44,0x5F,0x5F,0x5F,0x44,0x38,0x2C};
  const uint8_t p_end[]    = {0xAA,0x55,0x17,0x00,0x00,0x00,0x00,0x00,0x00,0x00,0x17};

  send_command(0xA3, &p, 1);
  delay(500);
  Serial.write(raw_init, sizeof(raw_init));
  delay(300);
  send_command_1(0xA4, 50);
  send_command_2(0xAF, energy);
  send_command_1(0xBE, 0x01);
  send_command_1(0xA9, 0x01);
  delay(300);
  send_command(0xA6, p_start, sizeof(p_start));

  for (uint16_t y = 0; y < label_height; y++) {
    render_row(row_buf, y);
    send_row(row_buf);
  }

  send_command(0xA6, p_end, sizeof(p_end));
  send_command(0xA3, &p, 1);
}

void print_rickroll() {
  reset_items();
  if (!generate_qr(RICKROLL_URL)) {
    return;
  }
  add_qr_centered(10, 4);
  add_text_rotated(4, 10, "RICKROLL", FONT_SCALE);
  print_label(240, 0x6000);
}

void setup() {
  Serial.begin(115200);
  pinMode(BUTTON_PIN, INPUT_PULLUP);
  delay(200);
  print_rickroll();
}

void loop() {
  static uint8_t lastRaw = HIGH;
  static uint8_t stable = HIGH;
  static uint32_t lastChangeMs = 0;

  const uint8_t raw = digitalRead(BUTTON_PIN);
  if (raw != lastRaw) {
    lastRaw = raw;
    lastChangeMs = millis();
  }

  if ((millis() - lastChangeMs) > BUTTON_DEBOUNCE_MS && stable != raw) {
    stable = raw;
    if (stable == LOW) {
      print_rickroll();
    }
  }
}
